## prj.conf
```kconfig
# Print a banner on the UART on startup.
CONFIG_BOOT_BANNER=y

# Enable console and printk()
CONFIG_PRINTK=y
CONFIG_STDOUT_CONSOLE=y

# Enable Zephyr application to be booted by MCUboot
CONFIG_BOOTLOADER_MCUBOOT=n

CONFIG_NRF_APPROTECT_USE_UICR=n

CONFIG_CLOCK_CONTROL_NRF_K32SRC_RC=y
```

## src/main.c
```c
/*
 * Copyright (c) 2012-2014 Wind River Systems, Inc.
 *
 * SPDX-License-Identifier: Apache-2.0
 */

 #include <stdio.h>
 #include <zephyr/kernel.h>
 
 int main(void)
 {
	 int i = 0;
	 while (1) {
		 printf("Hello World! %d %s\n", i, CONFIG_BOARD_TARGET);
		 i++;
		 k_sleep(K_MSEC(1000));
	 }
 
	 return 0;
 }
 
```
